## drivers/cpuidle/governors/Kconfig
```kconfig
# SPDX-License-Identifier: GPL-2.0-only
# CPU Idle governors — vendor extensions

config CPU_IDLE_GOV_QCOM_LPM
	tristate "Qualcomm Technologies, Inc. cpuidle LPM governor"
	depends on CPU_IDLE
	depends on SCHED_WALT
	help
	  This is the Qualcomm cpuidle low-power-mode governor that
	  selects the best CPU idle state based on WALT scheduler input
	  (window-assisted load tracking) plus per-cluster LPM constraints.
	  Targets sm8xxx PMIC-tier idle hierarchies including cluster-level
	  C-states beyond what mainline menu/teo governors expose.

	  The bundle compiles three source files into qcom_lpm.ko:
	  qcom-lpm.c (the governor itself), qcom-cluster-lpm.c (cluster-
	  level idle), and qcom-lpm-sysfs.c (debugfs/sysfs surface).

	  To compile as a module, choose M here: the module will be called
	  qcom_lpm.
```

## drivers/firmware/arm_scmi/Kconfig
```kconfig
# SPDX-License-Identifier: GPL-2.0-only
menu "ARM System Control and Management Interface Protocol"

# Vendor stripped this stanza; restored from upstream Linux 6.12.
config ARM_SCMI_PROTOCOL
	tristate "ARM System Control and Management Interface (SCMI) Message Protocol"
	depends on ARM || ARM64 || COMPILE_TEST
	help
	  ARM System Control and Management Interface (SCMI) protocol is a
	  set of operating system-independent software interfaces that are
	  used in system management. SCMI is extensible and currently
	  provides interfaces for: Discovery and self-description of the
	  interfaces it supports, Power domain management, Performance
	  management, Clock management, Sensor management, Reset domain
	  management, Voltage domain management.

if ARM_SCMI_PROTOCOL

config QTI_SCMI_PMU_PROTOCOL
	tristate "Qualcomm Technologies, Inc. SCMI PMU vendor Protocol"
	depends on ARM || ARM64 || COMPILE_TEST
	depends on ARM_SCMI_PROTOCOL && QCOM_CPUCP
	help
	  System Control and Management Interface (SCMI) pmu vendor protocol.
	  This protocol provides interface to communicate with micro controller
	  which maintains the PMU configuration for multiple clients.

	  This driver defines the commands or message ID's used for this
	  communication and also exposes the ops used by clients.

config QTI_SCMI_VENDOR_PROTOCOL
	tristate "Qualcomm Technologies, Inc. Qcom SCMI vendor Protocol"
	depends on ARM || ARM64 || COMPILE_TEST
	depends on ARM_SCMI_PROTOCOL && QCOM_CPUCP
	help
	  System Control and Management Interface (SCMI) Qcom vendor protocol.
	  This protocol provides interface to communicate with micro controller.

	  This driver defines the commands or message ID's used for this
	  communication and also exposes the ops used by clients.

config QTI_SCMI_C1DCVS_PROTOCOL
	tristate "Qualcomm Technologies, Inc. SCMI C1DCVS vendor Protocol"
	depends on ARM || ARM64 || COMPILE_TEST
	depends on ARM_SCMI_PROTOCOL && QCOM_CPUCP
	help
	  System Control and Management Interface (SCMI) c1dcvs vendor protocol.
	  This protocol provides interface to communicate with micro controller
	  which maintains the c1dcvs algorithm.

	  This driver defines the comands or message ID's used for this
	  communication and also exposes the ops used by clients.

config QTI_SCMI_PLH_PROTOCOL
	tristate "Qualcomm Technologies, Inc. SCMI PLH vendor Protocol"
	depends on ARM_SCMI_PROTOCOL && QCOM_CPUCP
	help
	  System Control and Management Interface (SCMI) plh vendor protocol
	  this protocol provides interface to communicate with micro controller
	  which is executing the plh algorithm.

	  This driver defines the comands or message ID's used for this
	  communication and also exposes the ops used by clients.

endif #ARM_SCMI_PROTOCOL

endmenu
```

## drivers/rpmsg/Kconfig
```kconfig
# SPDX-License-Identifier: GPL-2.0

menu "Rpmsg drivers"

# Vendor stripped these stanzas; restored from upstream Linux 6.12
# (drivers/rpmsg/Kconfig). Kleaf forces compile via module_outs so the
# stripped configs don't bite the vendor flow, but plain mka kernel
# silently drops obj-$(CONFIG_RPMSG_*) without these.
config RPMSG
	tristate

config RPMSG_CHAR
	tristate "RPMSG character device interface"
	depends on RPMSG_CTRL
	help
	  Say Y here to enable a userspace interface to the rpmsg bus on
	  remote processors connected to the Linux host. Each rpmsg device
	  appears as a character device under /dev as rpmsg_ctrl0 and
	  rpmsgN.

config RPMSG_CTRL
	tristate "RPMSG control interface"
	depends on RPMSG && (RPMSG_VIRTIO || RPMSG_QCOM_GLINK || RPMSG_QCOM_SMD)
	help
	  Say Y here to enable a /dev/rpmsg_ctrl interface that allows
	  userspace clients to create endpoints with specific name, src and
	  dst addresses.

config RPMSG_NS
	tristate "RPMSG name service announcement"
	depends on RPMSG
	help
	  Say Y here to enable the support of the name service announcement
	  channel that probes the associated RPMsg device on remote
	  endpoint service announcement.

config RPMSG_VIRTIO
	tristate "Virtio RPMSG bus driver"
	depends on HAS_DMA
	select RPMSG
	select RPMSG_NS
	select VIRTIO

# RPMSG always gets selected by whoever wants it
config RPMSG_QCOM_GLINK
	tristate
	select RPMSG

config RPMSG_QCOM_GLINK_RPM
	tristate "Qualcomm RPM Glink driver"
	select RPMSG_QCOM_GLINK
	depends on HAS_IOMEM
	depends on MAILBOX
	help
	  Say y here to enable support for the GLINK RPM communication driver,
	  which serves as a channel for communication with the RPM in GLINK
	  enabled systems.

config RPMSG_QCOM_GLINK_SMEM
	tristate "Qualcomm SMEM Glink driver"
	select RPMSG_QCOM_GLINK
	depends on MAILBOX
	depends on QCOM_SMEM
	help
	  Say y here to enable support for the GLINK SMEM communication driver,
	  which provides support for using the GLINK communication protocol
	  over SMEM.

config RPMSG_QCOM_GLINK_SPSS
	tristate "QTI SPSS Glink driver"
	select RPMSG_QCOM_GLINK_NATIVE
	depends on MAILBOX
	depends on QCOM_SMEM
	help
	  Say y here to enable support for the GLINK SPSS communication driver,
	  which provides support for using the GLINK communication protocol
	  over SMEM. This protocol maps the smem and then shares the mapped
	  region with the remote proc by writing the smem descriptor location
	  and size into shared registers.

config QCOM_GLINK_PKT
	tristate "Enable device interface for GLINK packet channels"
	depends on RPMSG_QCOM_GLINK_SMEM || RPMSG_QCOM_GLINK_SLATECOM
	help
	  G-link packet driver provides the interface for the userspace
	  clients to communicate over G-Link via device nodes.
	  This enable the userspace clients to read and write to
	  some glink packets channel.

config RPMSG_QCOM_SMD
	tristate "Qualcomm Shared Memory Driver (SMD)"
	depends on MAILBOX
	depends on QCOM_SMEM
	select RPMSG
	help
	  Say y here to enable support for the Qualcomm Shared Memory Driver
	  providing communication channels to remote processors in Qualcomm
	  platforms.

config RPMSG_QCOM_GLINK_CMA
        tristate "Qualcomm Technologies, Inc. CMA Glink driver"
        select RPMSG_QCOM_GLINK
        depends on MAILBOX
        help
          Say y here to enable support for the GLINK CMA communication driver.
          This provides support for using the GLINK communication protocol over
          share CMA region and IPC signaling. Enables communication channels
          to remote processors.
endmenu
```
